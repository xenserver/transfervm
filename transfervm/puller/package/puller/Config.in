## transfervm/puller/package/puller/Config.in
```kconfig
config BR2_PACKAGE_PULLER
        bool "puller"
        help
	  HTTP(S) client that pulls a VDI and pushes it into the local HTTPD.
```

## transfervm/xenstore/package/xenstore/Config.in
```kconfig
config BR2_PACKAGE_XENSTORE
        bool "xenstore"
        help
	  Minimal Xenstore client
```
